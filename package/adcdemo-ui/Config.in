## package/adcdemo-ui/Config.in
```kconfig
config BR2_PACKAGE_ADCDEMO_UI
    bool "adcdemo ui"
    select BR2_PACKAGE_BEAGLEVFIRE_ADCDEMO
    select BR2_PACKAGE_SAMPLER_GATEWARE
    select BR2_PACKAGE_SAMPLER_NET
    select BR2_PACKAGE_PYTHON3
    select BR2_PACKAGE_PYTHON_AIOHTTP
    select BR2_PACKAGE_BUSYBOX_SHOW_OTHERS
    select BR2_PACKAGE_COREUTILS
    select BR2_PACKAGE_HOST_NODEJS_BIN
    help
      UIO based ADC demo UI: aiohttp server (reads the mvaring shared
      memory ring written by bvf_adc_stream) and the React front-end.

      Mutually exclusive with the IIO based BR2_PACKAGE_SAMPLER (and
      its sampler-ui): those packages are hidden when this is enabled.
```

## package/beagleVFire_adcdemo/Config.in
```kconfig
config BR2_PACKAGE_BEAGLEVFIRE_ADCDEMO
    bool "beaglevfire adcdemo"
    help
      UIO based ADC streamer for BeagleV Fire. Reads samples from the
      FPGA sampler via UIO and DMA, and writes them to a ring-buffer in
      shared memory.
```

## package/sampler-gateware/Config.in
```kconfig
config BR2_PACKAGE_SAMPLER_GATEWARE
    bool "sampler gateware"
    help
      Sampler gateware.
```

## package/sampler-libiio/Config.in
```kconfig
config BR2_PACKAGE_SAMPLER_LIBIIO
    bool "sampler libiio"
    select BR2_TOOLCHAIN_HAS_THREADS
    select BR2_PACKAGE_LIBAIO
    select BR2_PACKAGE_LIBXML2
    select BR2_PACKAGE_ZSTD
    help
      LibIIO v1.0 and IIO Daemon.
```

## package/sampler-net/Config.in
```kconfig
config BR2_PACKAGE_SAMPLER_NET
    bool "sampler net"
    select BR2_PACKAGE_OPENSSH
    help
      Sampler network configuration package.
```

## package/sampler-ui/Config.in
```kconfig
config BR2_PACKAGE_SAMPLER_UI
    bool "sampler libiio wrapper"
    depends on !BR2_PACKAGE_ADCDEMO_UI
    select BR2_PACKAGE_LIGHTTPD
    select BR2_PACKAGE_LIGHTTPD_BZIP2
    select BR2_PACKAGE_SAMPLER_LIBIIO
    select BR2_PACKAGE_HOST_NODEJS_BIN
    help
      Sampler UI package.
```

## package/sampler/Config.in
```kconfig
config BR2_PACKAGE_SAMPLER
    bool "sampler"
    depends on !BR2_PACKAGE_ADCDEMO_UI
    select BR2_PACKAGE_SAMPLER_GATEWARE
    select BR2_PACKAGE_SAMPLER_NET
    select BR2_PACKAGE_SAMPLER_UI
    select BR2_PACKAGE_LINUX_TOOLS_IIO
    help
      Sampler package (IIO based). Hidden when BR2_PACKAGE_ADCDEMO_UI is
      enabled, the two demos are mutually exclusive.
```
